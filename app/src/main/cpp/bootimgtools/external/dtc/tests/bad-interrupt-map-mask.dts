/dts-v1/;

/ {
	interrupt-parent = <&intc>;
	intc: interrupt-controller {
		#interrupt-cells = <3>;
		interrupt-controller;
	};

	node {
		#address-cells = <0>;
		#interrupt-cells = <1>;
		interrupt-map = <1 &intc 1 2 3>;
		interrupt-map-mask = <0 0>;

		child {
			interrupts = <1>;
		};
	};
};
