/dts-v1/;

/ {
	interrupt-parent = <&intc>;
	intc: interrupt-controller {
		#interrupt-cells = <3>;
		interrupt-controller;
	};

	node {
		/* Missing #address-cells = <0>; */
		#interrupt-cells = <1>;
		interrupt-map = <1 &intc 1 2 3>;

		child {
			interrupts = <1>;
		};
	};
};
