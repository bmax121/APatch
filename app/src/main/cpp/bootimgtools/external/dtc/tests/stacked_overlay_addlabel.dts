/dts-v1/;
/plugin/;
/ {
	frag1: fragment@1 {
		target-path = "/foonode";
		local: localinfo {
		};
		foo: __overlay__ {
			overlay-1-property;
			bar: barnode {
				bar-property = "bar";
			};
		};
	};
};
